AUTOSAR XML (schema 00046)
package /AUTOSAR_Lin_43_LLCE/BswModuleDescriptions
  bsw module description Lin: module-id=82
    provided-entrys:
      Lin_CheckWakeup
      Lin_GetStatus
      Lin_GetVersionInfo
      Lin_GoToSleep
      Lin_GoToSleepInternal
      Lin_Init
      Lin_SendFrame
      Lin_Wakeup
      Lin_WakeupInternal
      Lin_CmdFromLlceIsr
    bsw internal behavior InternalBehavior_0
      9 x bsw called entity:
        Lin_43_LLCE_CheckWakeup: implemented-entry=Lin_CheckWakeup
        Lin_43_LLCE_GetStatus: implemented-entry=Lin_GetStatus
        Lin_43_LLCE_GetVersionInfo: implemented-entry=Lin_GetVersionInfo
        Lin_43_LLCE_GoToSleep: implemented-entry=Lin_GoToSleep
        Lin_43_LLCE_GoToSleepInternal: implemented-entry=Lin_GoToSleepInternal
        Lin_43_LLCE_Init: implemented-entry=Lin_Init
        Lin_43_LLCE_SendFrame: implemented-entry=Lin_SendFrame
        Lin_43_LLCE_Wakeup: implemented-entry=Lin_Wakeup
        Lin_43_LLCE_WakeupInternal: implemented-entry=Lin_WakeupInternal
      bsw interrupt entity Lin_CmdFromLlceIsr: implemented-entry=Lin_CmdFromLlceIsr, interrupt-category=CAT-2, interrupt-source=Hardware
package /AUTOSAR_Lin_43_LLCE/BswModuleEntrys
  10 x bsw module entry, all with sw-service-impl-policy=STANDARD:
    Lin_CheckWakeup: service-id=0x0a, is-reentrant=false, is-synchronous=true, call-type=REGULAR, execution-context=UNSPECIFIED
    Lin_GetStatus: service-id=0x08, is-reentrant=false, is-synchronous=true, call-type=REGULAR, execution-context=UNSPECIFIED
    Lin_GetVersionInfo: service-id=0x01, is-reentrant=true, is-synchronous=true, call-type=REGULAR, execution-context=UNSPECIFIED
    Lin_GoToSleep: service-id=0x06, is-reentrant=false, is-synchronous=false, call-type=REGULAR, execution-context=UNSPECIFIED
    Lin_GoToSleepInternal: service-id=0x09, is-reentrant=false, is-synchronous=true, call-type=REGULAR, execution-context=UNSPECIFIED
    Lin_Init: service-id=0x00, is-reentrant=false, is-synchronous=true, call-type=REGULAR, execution-context=UNSPECIFIED
    Lin_SendFrame: service-id=0x04, is-reentrant=false, is-synchronous=false, call-type=REGULAR, execution-context=UNSPECIFIED
    Lin_Wakeup: service-id=0x07, is-reentrant=false, is-synchronous=false, call-type=REGULAR, execution-context=UNSPECIFIED
    Lin_WakeupInternal: service-id=0x0b, is-reentrant=false, is-synchronous=false, call-type=REGULAR, execution-context=UNSPECIFIED
    Lin_CmdFromLlceIsr: service-id=0, is-reentrant=false, is-synchronous=true, call-type=INTERRUPT, execution-context=INTERRUPT-CAT-2
package /Lin_43_LLCE_TS_T40D11M10I10R0/Implementations
  bsw implementation BswImplementation_0: programming-language=C, sw-version=1.0.10, vendor-id=43, ar-release-version=4.4.0, behavior=InternalBehavior_0, vendor-api-infix=LLCE, vendor-specific-module-def=Lin
    code-descriptors:
      code Files
        artifact-descriptors:
          short-label=config::Lin_43_LLCE.xdm, category=SWCFG
          short-label=doc::RTD_LIN_LLCE_IM.pdf, category=SWDOC
          short-label=doc::RTD_LIN_LLCE_UM.pdf, category=SWDOC
          short-label=examples::S32DS::S32G2::Lin_Llce_DS_S32G274A_M7::include::check_example.h, category=SWHDR
          short-label=examples::S32DS::S32G2::Lin_Llce_DS_S32G274A_M7::include::Llce_Firmware_Load.h, category=SWHDR
          short-label=examples::S32DS::S32G2::Lin_Llce_DS_S32G274A_M7::include::PlatformInit.h, category=SWHDR
          short-label=examples::S32DS::S32G2::Lin_Llce_DS_S32G274A_M7::include::stubs.h, category=SWHDR
          short-label=examples::S32DS::S32G2::Lin_Llce_DS_S32G274A_M7::Project_Settings::Startup_Code::exceptions.c, category=SWSRC
          short-label=examples::S32DS::S32G2::Lin_Llce_DS_S32G274A_M7::Project_Settings::Startup_Code::nvic.c, category=SWSRC
          short-label=examples::S32DS::S32G2::Lin_Llce_DS_S32G274A_M7::Project_Settings::Startup_Code::startup.c, category=SWSRC
          short-label=examples::S32DS::S32G2::Lin_Llce_DS_S32G274A_M7::Project_Settings::Startup_Code::system.c, category=SWSRC
          short-label=examples::S32DS::S32G2::Lin_Llce_DS_S32G274A_M7::src::Llce_Firmware_Load.c, category=SWSRC
          short-label=examples::S32DS::S32G2::Lin_Llce_DS_S32G274A_M7::src::main.c, category=SWSRC
          short-label=examples::S32DS::S32G2::Lin_Llce_DS_S32G274A_M7::src::Platform_Init.c, category=SWSRC
          short-label=examples::S32DS::S32G2::Lin_Llce_DS_S32G274A_M7::src::stubs.c, category=SWSRC
          short-label=examples::S32DS::S32G3::Lin_Llce_DS_S32G399A_M7::include::check_example.h, category=SWHDR
          short-label=examples::S32DS::S32G3::Lin_Llce_DS_S32G399A_M7::include::Llce_Firmware_Load.h, category=SWHDR
          short-label=examples::S32DS::S32G3::Lin_Llce_DS_S32G399A_M7::include::PlatformInit.h, category=SWHDR
          short-label=examples::S32DS::S32G3::Lin_Llce_DS_S32G399A_M7::include::stubs.h, category=SWHDR
          short-label=examples::S32DS::S32G3::Lin_Llce_DS_S32G399A_M7::Project_Settings::Startup_Code::exceptions.c, category=SWSRC
          short-label=examples::S32DS::S32G3::Lin_Llce_DS_S32G399A_M7::Project_Settings::Startup_Code::nvic.c, category=SWSRC
          short-label=examples::S32DS::S32G3::Lin_Llce_DS_S32G399A_M7::Project_Settings::Startup_Code::startup.c, category=SWSRC
          short-label=examples::S32DS::S32G3::Lin_Llce_DS_S32G399A_M7::Project_Settings::Startup_Code::system.c, category=SWSRC
          short-label=examples::S32DS::S32G3::Lin_Llce_DS_S32G399A_M7::src::Llce_Firmware_Load.c, category=SWSRC
          short-label=examples::S32DS::S32G3::Lin_Llce_DS_S32G399A_M7::src::main.c, category=SWSRC
          short-label=examples::S32DS::S32G3::Lin_Llce_DS_S32G399A_M7::src::Platform_Init.c, category=SWSRC
          short-label=examples::S32DS::S32G3::Lin_Llce_DS_S32G399A_M7::src::stubs.c, category=SWSRC
          short-label=include::Lin_43_LLCE.h, category=SWHDR
          short-label=include::Lin_43_LLCE_IPW.h, category=SWHDR
          short-label=include::Lin_Llce.h, category=SWHDR
          short-label=include::Llce_FwVersion.h, category=SWHDR
          short-label=include::Llce_InterfaceCore2Core.h, category=SWHDR
          short-label=include::Llce_InterfaceFwMgr.h, category=SWHDR
          short-label=include::Llce_InterfaceLinTypes.h, category=SWHDR
          short-label=include::Llce_RegAccess.h, category=SWHDR
          short-label=src::Lin_43_LLCE.c, category=SWSRC
          short-label=src::Lin_Llce.c, category=SWSRC
          short-label=src::Lin_Llce_Irq.c, category=SWSRC
    compiler GCC_Compiler:
      name=GCC Compiler
      options=-mcpu=cortex-m7 -mthumb -mlittle-endian -mfpu=fpv5-sp-d16 -mfloat-abi=hard -std=c99 -Os -ggdb3 -Wall -Wextra -pedantic -Wstrict-prototypes -Wundef -Wunused -Werror=implicit-function-declaration -Wsign-compare -Wdouble-promotion -fno-short-enums -funsigned-char -funsigned-bitfields -fomit-frame-pointer -fno-common -fstack-usage -fdump-ipa-all -c -DUSE_SW_VECTOR_MODE -DD_CACHE_ENABLE -DI_CACHE_ENABLE -DENABLE_FPU -DMCAL_ENABLE_USER_MODE_SUPPORT
      vendor=GCC Systems
      version=NXP GCC 9.2.0 20190812 (Build 1649 Revision gaf57174) (for both S32G2 and S32G3)
    compiler GHS_Compiler:
      name=Green Hills
      options=-cpu=cortexm7 -thumb -fpu=vfpv5_d16 -fsingle -C99 --ghstd=last -Osize --gnu_asm -dual_debug -G -keeptempfiles -Wimplicit-int -Wshadow -Wtrigraphs -Wundef --unsigned_chars --unsigned_fields --no_commons --no_exceptions --no_slash_comment --prototype_errors --incorrect_pragma_warnings -c -DUSE_SW_VECTOR_MODE -DD_CACHE_ENABLE -DI_CACHE_ENABLE -DENABLE_FPU -DMCAL_ENABLE_USER_MODE_SUPPORT
      vendor=Green Hills
      version=Green Hills Multi 7.1.6d / Compiler 2020.1.4
    generated-artifacts:
      4 x dependency on artifact:
        Lin_43_LLCE_PBcfg_h: artifact-descriptor={short-label=generate_PB::include::Lin_43_LLCE_PBcfg.h, category=SWHDR}, usages=EXECUTE
        Lin_43_LLCE_PBcfg_c: artifact-descriptor={short-label=generate_PB::src::Lin_43_LLCE_PBcfg.c, category=SWSRC}, usages=EXECUTE
        Lin_43_LLCE_Cfg_h: artifact-descriptor={short-label=generate_PC::include::Lin_43_LLCE_Cfg.h, category=SWHDR}, usages=COMPILE
        Lin_43_LLCE_Cfg_c: artifact-descriptor={short-label=generate_PC::src::Lin_43_LLCE_Cfg.c, category=SWSRC}, usages=COMPILE
    linker GCC_Linker: name=GCC Compiler, options=-Wl,-Map,filename -T linkerfile --entry=Reset_Handler -nostartfiles -mcpu=cortexm7 -mthumb -mfpu=fpv5-sp-d16 -mfloat-abi=hard -mlittle-endian -ggdb3 -lc -lm -lgcc, vendor=GCC Systems, version=NXP GCC 9.2.0 20190812 (Build 1649 Revision gaf57174) (for both S32G2 and S32G3)
    linker GHS_Linker: name=Green Hills, options=-e Reset_Handler -T linker_script_file.ld -map -keepmap -Mn -delete -ignore_debug_references -Llibrary_path -larch -lstartup -lind_sd -v -nostartfiles, vendor=Green Hills, version=Green Hills Multi 7.1.6d / Compiler 2020.1.4
    resource consumption ResourceConsumption
      8 x memory section:
        LIN_43_LLCE_CODE: alignment=UNSPECIFIED, sw-addrmethod=CODE, symbol=CODE
        LIN_43_LLCE_CONFIG_DATA_UNSPECIFIED: alignment=UNSPECIFIED, sw-addrmethod=CONFIG_DATA, symbol=CONFIG_DATA_UNSPECIFIED
        LIN_43_LLCE_CONST_UNSPECIFIED: alignment=UNSPECIFIED, sw-addrmethod=CONST, symbol=CONST_UNSPECIFIED
        LIN_43_LLCE_SHAREDMEMORY: alignment=UNSPECIFIED, sw-addrmethod=SHAREDMEMORY, symbol=SHAREDMEMORY
        LIN_43_LLCE_VAR_CLEARED_8: alignment=8, sw-addrmethod=VAR_CLEARED, symbol=VAR_CLEARED_8
        LIN_43_LLCE_VAR_CLEARED_UNSPECIFIED: alignment=UNSPECIFIED, sw-addrmethod=VAR_CLEARED, symbol=VAR_CLEARED_UNSPECIFIED
        LIN_43_LLCE_VAR_INIT_8: alignment=8, sw-addrmethod=VAR_INIT, symbol=VAR_INIT_8
        LIN_43_LLCE_VAR_INIT_UNSPECIFIED: alignment=UNSPECIFIED, sw-addrmethod=VAR_INIT, symbol=VAR_INIT_UNSPECIFIED
